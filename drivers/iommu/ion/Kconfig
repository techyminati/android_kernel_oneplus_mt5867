## drivers/iommu/ion/Kconfig
```kconfig
menuconfig ION
	tristate "Ion Memory Manager"
	depends on HAS_DMA && MMU
	help
	  Choose this option to enable the ION Memory Manager,
	  used by Android to efficiently allocate buffers
	  from userspace that can be shared between drivers.
	  If you're not using Android its probably safe to
	  say N here.
```

## drivers/mtk-memory/Kconfig
```kconfig
config MTK_MEMORY
	tristate "MediaTek Memory Support"
        help
	  Say yes here to add support for the MediaTek Memory driver.
```
